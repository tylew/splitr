## CMakeLists.txt
```
#
# Copyright (c) 2024 Nordic Semiconductor ASA
#
# SPDX-License-Identifier: Apache-2.0
#

cmake_minimum_required(VERSION 3.20.0)

find_package(Zephyr REQUIRED HINTS $ENV{ZEPHYR_BASE})
project(rgb_led)

# Include utils directory for header files
zephyr_library_include_directories(
    src/utils
    src/utils/macros
)

# Application sources
target_sources(app PRIVATE 
    src/main.c
    src/utils/led.c
)
```

## Kconfig
```
#
# Copyright (c) 2024 Nordic Semiconductor ASA
#
# SPDX-License-Identifier: Apache-2.0
#

# Main menu configuration
mainmenu "RGB LED sample"

# Include Zephyr's Kconfig
source "Kconfig.zephyr"

menu "Main Configuration"

config MAIN_LOG_LEVEL
	int "Main module log level"
	range 0 4
	default 3
	help
	  Sets log level for main module.
	  0: off
	  1: error
	  2: warning
	  3: info
	  4: debug

endmenu # Main Configuration

# Include utils configuration
rsource "src/utils/Kconfig" 
```

## prj.conf
```kconfig
# Enable logging
CONFIG_LOG=y
CONFIG_LOG_DEFAULT_LEVEL=3
CONFIG_LOG_BACKEND_UART=y
CONFIG_LOG_PRINTK=y

# Module specific logging
CONFIG_MAIN_LOG_LEVEL=3
CONFIG_MODULE_LED_LOG_LEVEL=3

# Enable newlib for float printf support
CONFIG_NEWLIB_LIBC=y
CONFIG_NEWLIB_LIBC_FLOAT_PRINTF=y

# Enable PWM for LED control
CONFIG_PWM=y

# General debug settings
CONFIG_DEBUG=y
CONFIG_DEBUG_INFO=y
CONFIG_ASSERT=y
CONFIG_STACK_USAGE=y
CONFIG_THREAD_RUNTIME_STATS=y
CONFIG_STACK_SENTINEL=y
CONFIG_INIT_STACKS=y
```

## src/main.c
```c
/*
 * Copyright (c) 2016 Intel Corporation
 *
 * SPDX-License-Identifier: Apache-2.0
 */

/**
 * @file Sample app to demonstrate RGB LED control using LED module
 */

#include <zephyr/kernel.h>
#include <zephyr/sys/printk.h>
#include "utils/led.h"
#include "utils/macros/macros_common.h"

#include <zephyr/logging/log.h>
LOG_MODULE_REGISTER(main, CONFIG_MAIN_LOG_LEVEL);

int main(void)
{
	int ret;

	printk("RGB LED control using LED module\n");

	ret = led_init();
	ERR_CHK_MSG(ret, "LED module initialization failed");

	while (1) {
		// Cycle through basic colors
		ret = led_on(LED_APP_RGB, LED_COLOR_RED);
		ERR_CHK(ret);
		k_sleep(K_SECONDS(1));
		
		ret = led_on(LED_APP_RGB, LED_COLOR_GREEN);
		ERR_CHK(ret);
		k_sleep(K_SECONDS(1));
		
		ret = led_on(LED_APP_RGB, LED_COLOR_BLUE);
		ERR_CHK(ret);
		k_sleep(K_SECONDS(1));
		
		ret = led_on(LED_APP_RGB, LED_COLOR_WHITE);
		ERR_CHK(ret);
		k_sleep(K_SECONDS(1));
		
		ret = led_off(LED_APP_RGB);
		ERR_CHK(ret);
		k_sleep(K_SECONDS(1));
	}
	
	return 0;
}
```
