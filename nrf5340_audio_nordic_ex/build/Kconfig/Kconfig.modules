## nrf5340_audio_nordic_ex/build/Kconfig/Kconfig.modules
```kconfig
menu "nrf (/opt/nordic/ncs/v2.6.2/nrf)"
osource "/opt/nordic/ncs/v2.6.2/nrf/Kconfig.nrf"
config ZEPHYR_NRF_MODULE
	bool
	default y
endmenu
menu "mcuboot (/opt/nordic/ncs/v2.6.2/bootloader/mcuboot)"
osource "$(ZEPHYR_MCUBOOT_KCONFIG)"
config ZEPHYR_MCUBOOT_MODULE
	bool
	default y
endmenu
config ZEPHYR_PSA_ARCH_TESTS_MODULE
   bool
   default y
menu "cjson (/opt/nordic/ncs/v2.6.2/modules/lib/cjson)"
osource "$(ZEPHYR_CJSON_KCONFIG)"
config ZEPHYR_CJSON_MODULE
	bool
	default y
endmenu
menu "azure-sdk-for-c (/opt/nordic/ncs/v2.6.2/modules/lib/azure-sdk-for-c)"
osource "$(ZEPHYR_AZURE_SDK_FOR_C_KCONFIG)"
config ZEPHYR_AZURE_SDK_FOR_C_MODULE
	bool
	default y
endmenu
menu "cirrus-logic (/opt/nordic/ncs/v2.6.2/modules/hal/cirrus-logic)"
osource "/opt/nordic/ncs/v2.6.2/modules/hal/cirrus-logic/Kconfig"
config ZEPHYR_CIRRUS_LOGIC_MODULE
	bool
	default y
endmenu
menu "openthread (/opt/nordic/ncs/v2.6.2/modules/lib/openthread)"
osource "$(ZEPHYR_OPENTHREAD_KCONFIG)"
config ZEPHYR_OPENTHREAD_MODULE
	bool
	default y
endmenu
menu "memfault-firmware-sdk (/opt/nordic/ncs/v2.6.2/modules/lib/memfault-firmware-sdk)"
osource "/opt/nordic/ncs/v2.6.2/modules/lib/memfault-firmware-sdk/ports/zephyr/Kconfig"
config ZEPHYR_MEMFAULT_FIRMWARE_SDK_MODULE
	bool
	default y
endmenu
menu "canopennode (/opt/nordic/ncs/v2.6.2/modules/lib/canopennode)"
osource "$(ZEPHYR_CANOPENNODE_KCONFIG)"
config ZEPHYR_CANOPENNODE_MODULE
	bool
	default y
endmenu
menu "lz4 (/opt/nordic/ncs/v2.6.2/modules/lib/lz4)"
osource "$(ZEPHYR_LZ4_KCONFIG)"
config ZEPHYR_LZ4_MODULE
	bool
	default y
endmenu
config ZEPHYR_TF_M_TESTS_MODULE
   bool
   default y
menu "zscilib (/opt/nordic/ncs/v2.6.2/modules/lib/zscilib)"
osource "/opt/nordic/ncs/v2.6.2/modules/lib/zscilib/Kconfig.zscilib"
config ZEPHYR_ZSCILIB_MODULE
	bool
	default y
endmenu
menu "cmsis (/opt/nordic/ncs/v2.6.2/modules/hal/cmsis)"
osource "$(ZEPHYR_CMSIS_KCONFIG)"
config ZEPHYR_CMSIS_MODULE
	bool
	default y
endmenu
menu "cmsis-dsp (/opt/nordic/ncs/v2.6.2/modules/lib/cmsis-dsp)"
osource "$(ZEPHYR_CMSIS_DSP_KCONFIG)"
config ZEPHYR_CMSIS_DSP_MODULE
	bool
	default y
endmenu
menu "cmsis-nn (/opt/nordic/ncs/v2.6.2/modules/lib/cmsis-nn)"
osource "$(ZEPHYR_CMSIS_NN_KCONFIG)"
config ZEPHYR_CMSIS_NN_MODULE
	bool
	default y
endmenu
menu "fatfs (/opt/nordic/ncs/v2.6.2/modules/fs/fatfs)"
osource "$(ZEPHYR_FATFS_KCONFIG)"
config ZEPHYR_FATFS_MODULE
	bool
	default y
endmenu
menu "hal_nordic (/opt/nordic/ncs/v2.6.2/modules/hal/nordic)"
osource "$(ZEPHYR_HAL_NORDIC_KCONFIG)"
config ZEPHYR_HAL_NORDIC_MODULE
	bool
	default y
endmenu
config ZEPHYR_HAL_WURTHELEKTRONIK_MODULE
   bool
   default y
config ZEPHYR_LIBMETAL_MODULE
   bool
   default y
menu "liblc3 (/opt/nordic/ncs/v2.6.2/modules/lib/liblc3)"
osource "$(ZEPHYR_LIBLC3_KCONFIG)"
config ZEPHYR_LIBLC3_MODULE
	bool
	default y
endmenu
menu "littlefs (/opt/nordic/ncs/v2.6.2/modules/fs/littlefs)"
osource "$(ZEPHYR_LITTLEFS_KCONFIG)"
config ZEPHYR_LITTLEFS_MODULE
	bool
	default y
endmenu
menu "loramac-node (/opt/nordic/ncs/v2.6.2/modules/lib/loramac-node)"
osource "$(ZEPHYR_LORAMAC_NODE_KCONFIG)"
config ZEPHYR_LORAMAC_NODE_MODULE
	bool
	default y
endmenu
config ZEPHYR_MIPI_SYS_T_MODULE
   bool
   default y
config ZEPHYR_NRF_HW_MODELS_MODULE
   bool
   default y
config ZEPHYR_OPEN_AMP_MODULE
   bool
   default y
menu "segger (/opt/nordic/ncs/v2.6.2/modules/debug/segger)"
osource "$(ZEPHYR_SEGGER_KCONFIG)"
config ZEPHYR_SEGGER_MODULE
	bool
	default y
endmenu
config ZEPHYR_TINYCRYPT_MODULE
   bool
   default y
menu "uoscore-uedhoc (/opt/nordic/ncs/v2.6.2/modules/lib/uoscore-uedhoc)"
osource "$(ZEPHYR_UOSCORE_UEDHOC_KCONFIG)"
config ZEPHYR_UOSCORE_UEDHOC_MODULE
	bool
	default y
endmenu
menu "zcbor (/opt/nordic/ncs/v2.6.2/modules/lib/zcbor)"
osource "$(ZEPHYR_ZCBOR_KCONFIG)"
config ZEPHYR_ZCBOR_MODULE
	bool
	default y
endmenu
```

## nrf5340_audio_nordic_ex/build/Kconfig/Kconfig.sysbuild.modules
```kconfig
menu "nrf (/opt/nordic/ncs/v2.6.2/nrf)"
osource "/opt/nordic/ncs/v2.6.2/nrf/sysbuild/Kconfig.sysbuild"
config ZEPHYR_NRF_MODULE
	bool
	default y
endmenu
```

## nrf5340_ble_switching/Kconfig
```kconfig
CONFIG_BUTTON_1=0x0B  # Adjust pin number as needed
CONFIG_LOG_DEFAULT_LEVEL=3

# Audio configuration
config AUDIO_SAMPLE_RATE_HZ
    int "Audio sample rate in Hz"
    default 48000
    help
      Sample rate for audio processing

config AUDIO_BIT_DEPTH_BITS
    int "Audio bit depth in bits"
    default 16
    help
      Bit depth for audio samples

config AUDIO_FRAME_DURATION_US
    int "Audio frame duration in microseconds"
    default 10000
    help
      Duration of each audio frame

# Button configuration
config BUTTON_1
    int "GPIO pin number for mode switch button"
    default 11
    help
      GPIO pin number for the mode switch button

# Audio buffer sizes
config BUF_BLE_RX_PACKET_NUM
    int "Number of BLE RX packets to buffer"
    default 5
    help
      Number of BLE packets to buffer for audio reception

# Enable required features
config BT_AUDIO
    bool
    default y

config BT_BAP_BROADCAST_SOURCE
    bool
    default y if TRANSPORT_BIS

config BT_BAP_BROADCAST_SINK
    bool
    default y if TRANSPORT_BIS

config BT_BAP_SCAN_DELEGATOR
    bool
    default y if TRANSPORT_BIS

config AUDIO_SOURCE_I2S
    bool "Use I2S as audio source"
    default y
    help
      Enable I2S as the audio source/sink
```

## rgb_led/build/Kconfig/boards/Kconfig.defconfig
```kconfig
# Load Zephyr board defconfig descriptions.
osource "/opt/nordic/ncs/v3.0.0/zephyr/boards/nordic/nrf5340_audio_dk/Kconfig.defconfig"
```

## rgb_led/build/rgb_led/Kconfig/Kconfig.shield.defconfig
```kconfig
osource "/opt/nordic/ncs/v3.0.0/zephyr/samples/basic/rgb_led/boards/shields/*/Kconfig.defconfig"
```

## rgb_led/build/rgb_led/Kconfig/boards/Kconfig.nrf5340_audio_dk
```kconfig
# Load board Kconfig descriptions.
osource "/opt/nordic/ncs/v3.0.0/zephyr/boards/nordic/nrf5340_audio_dk/Kconfig.nrf5340_audio_dk"
```

## rgb_led/src/utils/Kconfig
```kconfig
#
# Copyright (c) 2024 Nordic Semiconductor ASA
#
# SPDX-License-Identifier: Apache-2.0
#

menu "LED Configuration"

config MODULE_LED
	bool "LED module"
	default y
	help
	  Enable LED module

if MODULE_LED

config MODULE_LED_LOG_LEVEL
	int "LED module log level"
	range 0 4
	default 3
	help
	  Sets log level for LED module.
	  0: off
	  1: error
	  2: warning
	  3: info
	  4: debug

endif # MODULE_LED

endmenu # LED Configuration
```
