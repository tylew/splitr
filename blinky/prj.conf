## CMakeLists.txt
```
# SPDX-License-Identifier: Apache-2.0

cmake_minimum_required(VERSION 3.20.0)
find_package(Zephyr REQUIRED HINTS $ENV{ZEPHYR_BASE})
project(nrf_audio_switch)

# List all source files by module
set(BUTTON_SRCS
    src/modules/button/button.c
)

set(LED_SRCS
    src/modules/led/led.c
)

set(BLE_SRCS
    src/modules/ble/ble.c
)

# Main application sources
set(APP_SRCS
    src/main.c
)

# Add all sources to the application
target_sources(app PRIVATE
    ${APP_SRCS}
    ${BUTTON_SRCS}
    ${LED_SRCS}
    ${BLE_SRCS}
)

# Add include directories
target_include_directories(app PRIVATE
    ${CMAKE_CURRENT_SOURCE_DIR}/src
    ${CMAKE_CURRENT_SOURCE_DIR}/src/modules
)
```

## prj.conf
```kconfig
CONFIG_GPIO=y
CONFIG_GPIO_INIT_PRIORITY=40
CONFIG_MAIN_STACK_SIZE=2048
CONFIG_PRINTK=y
CONFIG_LOG=y
CONFIG_BT=y
CONFIG_BT_AUDIO=y
```

## src/main.c
```c
#include <zephyr/kernel.h>
#include <zephyr/logging/log.h>
#include "button/button.h"
#include "led/led.h"
#include "ble/ble.h"

LOG_MODULE_REGISTER(main_app, LOG_LEVEL_INF);

static led_color_t current_color = LED_COLOR_RED;

static void button_pressed_callback(button_event_t event)
{
    if (event == BUTTON_PRESSED) {
        current_color = (current_color + 1) % LED_COLOR_MAX;
        led_set_color(current_color, LED_FULL);
        LOG_INF("Color changed to %d", current_color);
    }
}

static void ble_event_callback(ble_event_t event, void *data)
{
    switch (event) {
        case BLE_EVT_CONNECTED:
            LOG_INF("BLE connected");
            break;
        case BLE_EVT_DISCONNECTED:
            LOG_INF("BLE disconnected");
            break;
        case BLE_EVT_COLOR_CHANGED:
            if (data != NULL) {
                led_color_t color = *(led_color_t *)data;
                led_set_color(color, LED_FULL);
                current_color = color;
                LOG_INF("Color changed via BLE to %d", color);
            }
            break;
        case BLE_EVT_ERROR:
            LOG_ERR("BLE error occurred");
            break;
    }
}

void main(void)
{
    LOG_INF("App start: setting up");

    CHECK_ERROR(button_init());
    CHECK_ERROR(led_init());
    CHECK_ERROR(ble_init());

    CHECK_ERROR(button_register_callback(button_pressed_callback));
    CHECK_ERROR(ble_register_callback(ble_event_callback));
    
    led_set_color(current_color, LED_FULL);
    ble_start_advertising();

    LOG_INF("Application initialized successfully");

    while (1) {
        k_sleep(K_FOREVER);
    }
}
```

## src/led.c
```c
#include "led.h"
#include <zephyr/logging/log.h>

LOG_MODULE_REGISTER(led, LOG_LEVEL_INF);

static const struct gpio_dt_spec led_red = GPIO_DT_SPEC_GET(LED_RED_NODE, gpios);
static const struct gpio_dt_spec led_green = GPIO_DT_SPEC_GET(LED_GREEN_NODE, gpios);
static const struct gpio_dt_spec led_blue = GPIO_DT_SPEC_GET(LED_BLUE_NODE, gpios);

static int current_color = 0;

void led_set_color(int color)
{
    if (color < 0 || color > 2) {
        LOG_ERR("Invalid color value: %d", color);
        return;
    }

    gpio_pin_set_dt(&led_red,   color == 0);
    gpio_pin_set_dt(&led_green, color == 1);
    gpio_pin_set_dt(&led_blue,  color == 2);
    
    current_color = color;
    LOG_INF("LED color set to %d", color);
}

int led_init(void)
{
    if (!device_is_ready(led_red.port) ||
        !device_is_ready(led_green.port) ||
        !device_is_ready(led_blue.port)) {
        LOG_ERR("LED devices not ready");
        return -ENODEV;
    }

    gpio_pin_configure_dt(&led_red, GPIO_OUTPUT_INACTIVE);
    gpio_pin_configure_dt(&led_green, GPIO_OUTPUT_INACTIVE);
    gpio_pin_configure_dt(&led_blue, GPIO_OUTPUT_INACTIVE);

    LOG_INF("LEDs initialized");
    return 0;
} 
```

## src/main_old.c
```c
#include <zephyr/kernel.h>
#include <zephyr/device.h>
#include <zephyr/drivers/gpio.h>
#include <zephyr/sys/printk.h>

#define BUTTON5_NODE    DT_ALIAS(sw4)
#define LED_RED_NODE    DT_ALIAS(led0)
#define LED_GREEN_NODE  DT_ALIAS(led1)
#define LED_BLUE_NODE   DT_ALIAS(led2)

#define DEBOUNCE_MS 50

static const struct gpio_dt_spec button5 = GPIO_DT_SPEC_GET_OR(BUTTON5_NODE, gpios, {0});
static const struct gpio_dt_spec led_red = GPIO_DT_SPEC_GET(LED_RED_NODE, gpios);
static const struct gpio_dt_spec led_green = GPIO_DT_SPEC_GET(LED_GREEN_NODE, gpios);
static const struct gpio_dt_spec led_blue = GPIO_DT_SPEC_GET(LED_BLUE_NODE, gpios);

static struct gpio_callback button_cb_data;
static int current_color = 0;

static void update_leds(int color)
{
    gpio_pin_set_dt(&led_red,   color == 0);
    gpio_pin_set_dt(&led_green, color == 1);
    gpio_pin_set_dt(&led_blue,  color == 2);
}

void button_pressed(const struct device *dev, struct gpio_callback *cb, uint32_t pins)
{
    static int64_t last_press = 0;
    int64_t now = k_uptime_get();

    if (now - last_press < DEBOUNCE_MS) return;
    last_press = now;

    current_color = (current_color + 1) % 3;
    update_leds(current_color);
    printk("Color changed to %d\n", current_color);
}

int main(void)
{
    if (!device_is_ready(button5.port) ||
        !device_is_ready(led_red.port) ||
        !device_is_ready(led_green.port) ||
        !device_is_ready(led_blue.port)) {
        printk("Error: device not ready.\n");
        return 1;
    }

    gpio_pin_configure_dt(&button5, GPIO_INPUT);
    gpio_pin_interrupt_configure_dt(&button5, GPIO_INT_EDGE_TO_ACTIVE);
    gpio_init_callback(&button_cb_data, button_pressed, BIT(button5.pin));
    gpio_add_callback(button5.port, &button_cb_data);

    gpio_pin_configure_dt(&led_red, GPIO_OUTPUT_INACTIVE);
    gpio_pin_configure_dt(&led_green, GPIO_OUTPUT_INACTIVE);
    gpio_pin_configure_dt(&led_blue, GPIO_OUTPUT_INACTIVE);

    printk("Ready to rumble with RGB control on Button 5\n");

    while (1) {
        k_sleep(K_FOREVER); // Let ISR handle everything
    }
}
```
